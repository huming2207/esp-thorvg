## Kconfig
```kconfig
menu "ThorVG Support Options"

    config THORVG_LOG_ENABLED
        bool "Enable ThorVG log"
        default n
        help
            Enable ThorVG log.

    config THORVG_THREAD_ENABLED
        bool "Enable ThorVG threading support"
        default y
        help
            Enable ThorVG threading support. This option can be disabled if ThorVG is only used from one FreeRTOS task.

    config THORVG_SIMD_ENABLED
        bool "Accelerate the CPU rasterizer with PIE SIMD (experimental)"
        depends on SOC_CPU_HAS_PIE && IDF_TARGET_ARCH_RISCV
        depends on !(IDF_TARGET_ESP32S31 && FREERTOS_UNICORE)
        default y
        help
            Use the PIE SIMD extension of ESP32-P4 and ESP32-S31 for the solid fills,
            the translucent spans and the Rgb565 fills of the CPU rasterizer.

            On ESP32-S31 only core 1 has PIE: create the rendering task pinned to core 1.
            Otherwise FreeRTOS migrates the task to core 1 on its first PIE instruction.
            Do not render from an ISR or inside a critical section, as PIE use there aborts.

    config THORVG_QUICKJS
        bool "QuickJS bindings (webcanvas-style JS API)"
        default n
        help
            Build js/, a QuickJS module shaped after @thorvg/webcanvas.
            Needs a QuickJS component in the build, see THORVG_QUICKJS_COMPONENT.

    config THORVG_QUICKJS_COMPONENT
        string "QuickJS component name"
        depends on THORVG_QUICKJS
        default "esp-quickjs-ng"
        help
            Name of the component providing quickjs.h, as the build sees it
            (directory name, or e.g. "huming2207__esp-quickjs-ng" when it comes
            from the component manager).

    config THORVG_JS_MAX_SURFACES
        int "Max framebuffers registered for JS"
        depends on THORVG_QUICKJS
        range 1 16
        default 2
        help
            Size of the static table behind tvg_js_add_surface().

    menu "Loaders Support"

        config THORVG_LOTTIE_LOADER_SUPPORT
            bool "Enable Lottie loader support"
            default y

        config THORVG_SVG_LOADER_SUPPORT
            bool "Enable svg loader support"
            default y

        config THORVG_PNG_LOADER_SUPPORT
            bool "Enable png loader support"
            default n

        config THORVG_JPEG_LOADER_SUPPORT
            bool "Enable jpeg loader support"
            default n

        config THORVG_WEBP_LOADER_SUPPORT
            bool "Enable webp loader support"
            default n

        config THORVG_TTF_LOADER_SUPPORT
            bool "Enable TTF font loader support"
            default y

    endmenu

endmenu
```
